#include "config.h"
#include "bsp_i2c.h"

#define I2C_SCLK_PIN       GPIO_PIN_2    
#define I2C_SDA_PIN        GPIO_PIN_9 


#define	SDA_High() 		  	           HT_GPIOC->SRR = GPIO_PIN_9
#define	SDA_Low()    			           HT_GPIOC->RR = GPIO_PIN_9

#define	SDA_Read()                  GPIO_ReadInBit(HT_GPIOC,GPIO_PIN_9)// (HT_GPIOC->DINR & GPIO_PIN_9)   // GPIO_ReadInBit(HT_GPIOC,GPIO_PIN_15)

#define SCL_High()                   HT_GPIOC->SRR = GPIO_PIN_2
#define SCL_Low()                    HT_GPIOC->RR = GPIO_PIN_2

#define Delay_counts  80
/*******************************************************************************************************
** 函数: DelayAt24c02, SPI延时函数
**------------------------------------------------------------------------------------------------------
** 参数:  ms 时间 
** 返回: void
*******************************************************************************************************/
static void DelayAt24c02(unsigned long ms)
{	
	while(ms--);
}

/*******************************************************************************************************
** 函数: I2c_GpioInit 初始化
**------------------------------------------------------------------------------------------------------
** 参数: void 
** 返回: void
*******************************************************************************************************/
void I2c_GpioInit(void)
{
		CKCU_PeripClockConfig_TypeDef CKCUClock = {{0}};
    CKCUClock.Bit.PC         = 1;
    CKCUClock.Bit.AFIO       = 1;
    CKCUClock.Bit.BKP        = 1;
    CKCU_PeripClockConfig(CKCUClock, ENABLE);
  //配置SCL,SDA为开漏
		

		GPIO_OpenDrainConfig(HT_GPIOC, I2C_SCLK_PIN, ENABLE);
		GPIO_DirectionConfig(HT_GPIOC, I2C_SCLK_PIN, GPIO_DIR_OUT);	 
		AFIO_GPxConfig(GPIO_PC, I2C_SCLK_PIN, AFIO_MODE_DEFAULT);		
		

		GPIO_OpenDrainConfig(HT_GPIOC,I2C_SDA_PIN,ENABLE);
		GPIO_DirectionConfig(HT_GPIOC, I2C_SDA_PIN, GPIO_DIR_OUT);  
		GPIO_InputConfig(HT_GPIOC, I2C_SDA_PIN,ENABLE);
			AFIO_GPxConfig(GPIO_PC, I2C_SDA_PIN, AFIO_MODE_DEFAULT);	
			SDA_High();
		  SCL_High();
			DelayAt24c02(0xfff);

}



/*******************************************************************************************************
** 函数: I2cStart,I2C开始信号
**------------------------------------------------------------------------------------------------------
** 参数: void
** 返回: void
********************************************************************************************************/
void I2cStart(void)
{	
	SDA_High();
	SCL_High();
	DelayAt24c02(Delay_counts);
	SDA_Low();
DelayAt24c02(20);		
	SCL_Low();

}
/*******************************************************************************************************
** 函数: I2cStop,I2C停止信号
**------------------------------------------------------------------------------------------------------
** 参数: void
** 返回: void
********************************************************************************************************/
void I2cStop( void )
{	
	SDA_Low();
	DelayAt24c02(15);
	SCL_Low();
	DelayAt24c02(Delay_counts);
	SCL_High();
	DelayAt24c02(15);
	SDA_High();
	DelayAt24c02(0XfF);	
}
/*******************************************************************************************************
** 函数: I2cACK,应答读信号
**------------------------------------------------------------------------------------------------------
** 参数: void
** 返回: void
********************************************************************************************************/
void I2cACK(void)
{	
	SCL_Low();
	SDA_Low();
	SCL_High();
	DelayAt24c02(Delay_counts);
	SCL_Low();
	DelayAt24c02(20);	
	SDA_High();
}
/*******************************************************************************************************
** 函数: I2cNoACK,非应答信号
**------------------------------------------------------------------------------------------------------
** 参数: void
** 返回: void
********************************************************************************************************/
void I2cNoACK(void)
{	
	SCL_Low();          //一定要先拉低
	SDA_High();
	SCL_High();
	DelayAt24c02(Delay_counts);
	SCL_Low();	
	
}

/*******************************************************************************************************
** 函数: I2cRACK,读取应答信号
**------------------------------------------------------------------------------------------------------
** 参数: void
** 返回: 有应答=1,无应答=0
********************************************************************************************************/
int I2cRACK(void) 	 
{
	int bat=0;
	SCL_Low();
	SDA_High(); 
	DelayAt24c02(5);
	SCL_High();

	DelayAt24c02(Delay_counts);
	bat = SDA_Read();
	SCL_Low();
	return bat;
}


/*******************************************************************************************************
** 函数: I2cWriteByte,写一字节数据
**------------------------------------------------------------------------------------------------------
** 参数: b 数据
** 返回: void
********************************************************************************************************/
void I2cWriteByte(unsigned char date)
{	
	unsigned char i=0,z;
	for(i=0;i<8;i++)
	{
		z = (date&0x80)?1:0;
		if(z)
		{
			SDA_High();	
		}
		else
		{
			SDA_Low();	
		}	
		DelayAt24c02(20);	
		SCL_High();		
		DelayAt24c02(Delay_counts);
		SCL_Low();
		date<<=1;
	}
}

/*******************************************************************************************************
** 函数: I2cReadByte,读取一字节
**------------------------------------------------------------------------------------------------------
** 参数: dat 数据指针
** 返回: void
********************************************************************************************************/
void I2cReadByte(unsigned char *dat)
{	
	unsigned char i;

	for(i=0;i<8;i++)
	{
		*dat <<= 1;
		SCL_High();
		DelayAt24c02(Delay_counts);
		*dat |= SDA_Read();
		SCL_Low();
	DelayAt24c02(Delay_counts);	
	}
}

